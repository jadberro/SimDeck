#include "SimDeckClient.h"

#include <HTTPClient.h>
#include <Update.h>
#include <WiFi.h>
#include <math.h>

#include "mbedtls/sha256.h"

// Arduino-ESP32 v3 moved to IDF 5.x and dropped the _ret suffixed mbedtls
// entry points. v2 still needs them.
#if defined(ESP_ARDUINO_VERSION_MAJOR) && ESP_ARDUINO_VERSION_MAJOR >= 3
  #define SHA_STARTS(c)        mbedtls_sha256_starts((c), 0)
  #define SHA_UPDATE(c, b, n)  mbedtls_sha256_update((c), (b), (n))
  #define SHA_FINISH(c, o)     mbedtls_sha256_finish((c), (o))
#else
  #define SHA_STARTS(c)        mbedtls_sha256_starts_ret((c), 0)
  #define SHA_UPDATE(c, b, n)  mbedtls_sha256_update_ret((c), (b), (n))
  #define SHA_FINISH(c, o)     mbedtls_sha256_finish_ret((c), (o))
#endif

static const uint32_t HELLO_INTERVAL = 3000;
static const uint32_t HELLO_IDLE     = 15000;
static const uint32_t PING_INTERVAL  = 2000;
static const uint32_t DATA_TIMEOUT   = 1500;

// ---------------------------------------------------------------------------
// minimal JSON field extraction
//
// Every inbound message is generated by our own hub, so a full parser buys
// nothing. These handle exactly the shapes the hub emits.
// ---------------------------------------------------------------------------

static String jsonStr(const char* src, const char* key) {
  String pat = String("\"") + key + "\":\"";
  const char* p = strstr(src, pat.c_str());
  if (!p) return String();
  p += pat.length();
  const char* e = strchr(p, '"');
  if (!e) return String();
  return String(p).substring(0, e - p);
}

static uint32_t jsonNum(const char* src, const char* key) {
  String pat = String("\"") + key + "\":";
  const char* p = strstr(src, pat.c_str());
  if (!p) return 0;
  return (uint32_t)strtoul(p + pat.length(), nullptr, 10);
}

static String escapeJson(const char* s) {
  if (!s) return "";
  String res = "";
  while (*s) {
    if (*s == '"') res += "\\\"";
    else if (*s == '\\') res += "\\\\";
    else res += *s;
    s++;
  }
  return res;
}

// ---------------------------------------------------------------------------

void SimDeckClient::begin(const char* moduleId, const char* moduleType,
                         const char* displayName, const char* fwVersion,
                         const char* const* names, uint8_t count,
                         float rateHz, const char* hubIp) {
  _id = moduleId;
  _type = moduleType;
  _name = displayName;
  _fw = fwVersion;
  _names = names;
  _count = count > SIMDECK_MAX_SLOTS ? SIMDECK_MAX_SLOTS : count;
  _rate = rateHz;

  for (uint8_t i = 0; i < SIMDECK_MAX_SLOTS; i++) _values[i] = NAN;

  if (hubIp && *hubIp) {
    if (_hubIp.fromString(hubIp)) {
      _haveHub = true;
      Serial.printf("[SimDeck] Configured Hub IP: %s\n", hubIp);
    }
  }

  _udp.begin(SIMDECK_MODULE_PORT);
  Serial.printf("[SimDeck] Listening on UDP %d\n", SIMDECK_MODULE_PORT);
  sendHello();
}

void SimDeckClient::sendCtrl(const String& json) {
  // Before the hub is known, broadcast. Its IP never has to be compiled in.
  if (_haveHub) {
    _udp.beginPacket(_hubIp, SIMDECK_CTRL_PORT);
    _udp.print(json);
    _udp.endPacket();
  } else {
    IPAddress dest = WiFi.localIP();
    dest[3] = 255;
    _udp.beginPacket(dest, SIMDECK_CTRL_PORT);
    _udp.print(json);
    _udp.endPacket();

    // Also send to 255.255.255.255 in case router drops directed broadcast
    _udp.beginPacket(IPAddress(255, 255, 255, 255), SIMDECK_CTRL_PORT);
    _udp.print(json);
    _udp.endPacket();
  }
}

void SimDeckClient::sendHello() {
  String msg = "{\"t\":\"hello\",\"id\":\"";
  msg += escapeJson(_id);
  msg += "\",\"type\":\"";
  msg += escapeJson(_type);
  msg += "\",\"name\":\"";
  msg += escapeJson(_name);
  msg += "\",\"fw\":\"";
  msg += escapeJson(_fw);
  msg += "\",\"rate\":";
  msg += String(_rate, 0);
  msg += ",\"sub\":[";
  for (uint8_t i = 0; i < _count; i++) {
    if (i) msg += ",";
    msg += "\"";
    msg += escapeJson(_names[i]);
    msg += "\"";
  }
  msg += "]}";
  sendCtrl(msg);
  Serial.printf("[SimDeck] Announce sent to %s:%d\n",
                _haveHub ? _hubIp.toString().c_str() : "broadcast", SIMDECK_CTRL_PORT);
  _lastHello = millis();
}

void SimDeckClient::sendPing() {
  if (!_haveHub) return;
  sendCtrl(String("{\"t\":\"ping\",\"id\":\"") + _id + "\"}");
  _lastPing = millis();
}

void SimDeckClient::sendEvent(const char* inputId, float value) {
  if (!_haveHub) return;
  String msg = "{\"t\":\"ev\",\"id\":\"";
  msg += _id;
  msg += "\",\"in\":\"";
  msg += inputId;
  msg += "\",\"v\":";
  msg += String(value, 4);
  msg += "}";
  sendCtrl(msg);
}

void SimDeckClient::otaStatus(const char* state, int pct, const char* err) {
  String msg = "{\"t\":\"ota_status\",\"id\":\"";
  msg += _id;
  msg += "\",\"state\":\"";
  msg += state;
  msg += "\",\"pct\":";
  msg += pct;
  if (err && *err) {
    msg += ",\"err\":\"";
    msg += err;
    msg += "\"";
  }
  msg += "}";
  sendCtrl(msg);
}

// ---------------------------------------------------------------------------
// OTA
// ---------------------------------------------------------------------------

void SimDeckClient::runOta(const String& url, const String& sha, uint32_t size) {
  _updating = true;
  otaStatus("start", 0, nullptr);

  HTTPClient http;
  http.setTimeout(15000);
  if (!http.begin(url)) {
    otaStatus("fail", 0, "bad url");
    _updating = false;
    return;
  }

  int code = http.GET();
  if (code != HTTP_CODE_OK) {
    http.end();
    otaStatus("fail", 0, String(String("http ") + code).c_str());
    _updating = false;
    return;
  }

  int len = http.getSize();
  if (len <= 0) len = (int)size;
  if (len <= 0) {
    http.end();
    otaStatus("fail", 0, "unknown size");
    _updating = false;
    return;
  }

  if (!Update.begin(len)) {
    http.end();
    // Nearly always a partition scheme with no second app slot.
    otaStatus("fail", 0, "no ota partition");
    _updating = false;
    return;
  }

  mbedtls_sha256_context ctx;
  mbedtls_sha256_init(&ctx);
  SHA_STARTS(&ctx);

  WiFiClient* stream = http.getStreamPtr();
  uint8_t buf[1024];
  int written = 0;
  int lastPct = -5;
  uint32_t lastData = millis();
  bool failed = false;

  while (written < len) {
    size_t avail = stream->available();
    if (avail) {
      int n = stream->readBytes(buf, avail > sizeof(buf) ? sizeof(buf) : avail);
      if (n <= 0) break;
      SHA_UPDATE(&ctx, buf, n);
      if ((int)Update.write(buf, n) != n) {
        failed = true;
        break;
      }
      written += n;
      lastData = millis();

      int pct = (int)((written * 100L) / len);
      if (pct >= lastPct + 5) {
        lastPct = pct;
        otaStatus("progress", pct, nullptr);
      }
    } else {
      if (!http.connected() || millis() - lastData > 10000) {
        failed = true;
        break;
      }
      delay(1);
    }
  }
  http.end();

  uint8_t digest[32];
  SHA_FINISH(&ctx, digest);
  mbedtls_sha256_free(&ctx);

  char hex[65];
  for (int i = 0; i < 32; i++) sprintf(hex + i * 2, "%02x", digest[i]);
  hex[64] = 0;

  if (failed || written != len) {
    Update.abort();
    otaStatus("fail", 0, "transfer incomplete");
    _updating = false;
    return;
  }

  // Verify before committing. A corrupt image that passes Update.end()
  // bricks the module until someone gets a USB cable to it.
  if (sha.length() == 64 && !sha.equalsIgnoreCase(hex)) {
    Update.abort();
    otaStatus("fail", 0, "sha256 mismatch");
    _updating = false;
    return;
  }

  if (!Update.end(true)) {
    otaStatus("fail", 0, String(Update.errorString()).c_str());
    _updating = false;
    return;
  }

  otaStatus("ok", 100, nullptr);
  delay(250);            // let the datagram leave before we go down
  ESP.restart();
}

// ---------------------------------------------------------------------------

void SimDeckClient::handleFrame(const uint8_t* buf, int len) {
  if (len < SIMDECK_HEADER_LEN) return;
  if (buf[0] != SIMDECK_DATA_MAGIC || buf[1] != SIMDECK_PROTO_VERSION) return;

  uint16_t seq;
  memcpy(&seq, buf + 2, 2);
  uint8_t count = buf[4];
  uint8_t flags = buf[5];

  // Drop out-of-order datagrams. The signed diff handles wraparound.
  int16_t diff = (int16_t)(seq - _lastSeq);
  if (_lastFrame && diff <= 0) return;
  _lastSeq = seq;

  if (len < SIMDECK_HEADER_LEN + 4 * count) return;
  if (count > SIMDECK_MAX_SLOTS) count = SIMDECK_MAX_SLOTS;

  for (uint8_t i = 0; i < count; i++) {
    float v;
    memcpy(&v, buf + SIMDECK_HEADER_LEN + 4 * i, 4);
    // NaN means the hub could not resolve it - hold the last good value.
    if (!isnan(v)) _values[i] = v;
  }

  _flags = flags;
  _lastFrame = millis();
  _linked = true;
}

void SimDeckClient::handleJson(const char* text) {
  if (strstr(text, "\"welcome\"")) {
    _linked = true;
    Serial.printf("[SimDeck] Linked! Received welcome from Hub at %s\n", _hubIp.toString().c_str());
    return;
  }
  if (strstr(text, "\"identify\"")) {
    Serial.println("[SimDeck] Identify command received");
    if (_identify) _identify();
    return;
  }
  if (strstr(text, "\"t\":\"ota\"")) {
    String url = jsonStr(text, "url");
    String sha = jsonStr(text, "sha256");
    uint32_t size = jsonNum(text, "size");
    if (url.length()) runOta(url, sha, size);
    return;
  }
}

void SimDeckClient::poll() {
  int sz = _udp.parsePacket();
  while (sz > 0) {
    static uint8_t buf[SIMDECK_HEADER_LEN + 4 * SIMDECK_MAX_SLOTS + 512];
    int len = _udp.read(buf, sizeof(buf) - 1);
    if (len > 0) {
      if (!_haveHub || _hubIp != _udp.remoteIP()) {
        _hubIp = _udp.remoteIP();
        _haveHub = true;
        Serial.printf("[SimDeck] Discovered Hub at %s\n", _hubIp.toString().c_str());
      }
      if (buf[0] == SIMDECK_DATA_MAGIC) {
        handleFrame(buf, len);
      } else {
        buf[len] = 0;
        handleJson((const char*)buf);
      }
    }
    sz = _udp.parsePacket();
  }

  uint32_t now = millis();

  // Re-announce periodically. Cheap, and it means a hub restart or a module
  // reboot both recover without anyone touching anything.
  if (now - _lastHello > (_linked ? HELLO_IDLE : HELLO_INTERVAL)) sendHello();
  if (now - _lastPing > PING_INTERVAL) sendPing();
  if (_lastFrame && now - _lastFrame > DATA_TIMEOUT) _linked = false;
}

float SimDeckClient::value(uint8_t slot) const {
  if (slot >= _count) return NAN;
  return _values[slot];
}

bool SimDeckClient::live() const {
  return _linked && (_flags & SIMDECK_FLAG_SIM_OK);
}
