// gauge_geometry.h - GENERATED by artwork/make_360_assets.py
// Single source of truth: artwork/build/geometry_360.json
// Angles: degrees, 0 = east, positive = clockwise, y down.
#pragma once

#include <Arduino.h>

#define DIAL_SIZE 360

// Fixed light direction shadow offset
#define SHADOW_DX 3
#define SHADOW_DY 4

// needle_accu bitmap: size and pivot inside art
#define NEEDLE_ACCU_ART_W       25
#define NEEDLE_ACCU_ART_H       81
#define NEEDLE_ACCU_ART_PIVOT_X 12
#define NEEDLE_ACCU_ART_PIVOT_Y 78

// needle_brake bitmap: size and pivot inside art
#define NEEDLE_BRAKE_ART_W       25
#define NEEDLE_BRAKE_ART_H       80
#define NEEDLE_BRAKE_ART_PIVOT_X 12
#define NEEDLE_BRAKE_ART_PIVOT_Y 77

// Accumulator
#define ACCUM_PIVOT_X    180.2f
#define ACCUM_PIVOT_Y    71.7f
#define ACCUM_VMIN       0.0f
#define ACCUM_VMAX       4.0f
#define ACCUM_AMIN       138.5f
#define ACCUM_AMAX       44.6f
#define ACCUM_NEEDLE_LEN 76.8f

// Brake Left (Piecewise linear: 0.0->1.2, 1.0->-46.0, 3.0->-103.0)
#define BRAKE_L_PIVOT_X    70.1f
#define BRAKE_L_PIVOT_Y    261.1f
#define BRAKE_L_VMIN       0.0f
#define BRAKE_L_VMAX       3.0f
#define BRAKE_L_NEEDLE_LEN 75.6f

// Brake Right (Piecewise linear: 0.0->179.0, 1.0->225.5, 3.0->283.0)
#define BRAKE_R_PIVOT_X    291.5f
#define BRAKE_R_PIVOT_Y    261.5f
#define BRAKE_R_VMIN       0.0f
#define BRAKE_R_VMAX       3.0f
#define BRAKE_R_NEEDLE_LEN 75.6f

struct CalPoint {
  float val;
  float deg;
};

static const CalPoint ACCU_POINTS[2] = {
  {0.0f, 138.5f},
  {4.0f, 44.6f}
};

static const CalPoint BRAKE_L_POINTS[3] = {
  {0.0f, 1.2f},
  {1.0f, -46.0f},
  {3.0f, -103.0f}
};

static const CalPoint BRAKE_R_POINTS[3] = {
  {0.0f, 179.0f},
  {1.0f, 225.5f},
  {3.0f, 283.0f}
};

inline float interpolate_gauge_angle(float val, const CalPoint* pts, int count) {
  if (val <= pts[0].val) return pts[0].deg;
  if (val >= pts[count - 1].val) return pts[count - 1].deg;
  for (int i = 0; i < count - 1; ++i) {
    if (val >= pts[i].val && val <= pts[i + 1].val) {
      float t = (val - pts[i].val) / (pts[i + 1].val - pts[i].val);
      return pts[i].deg + t * (pts[i + 1].deg - pts[i].deg);
    }
  }
  return pts[count - 1].deg;
}
